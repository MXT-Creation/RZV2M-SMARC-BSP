## build/conf/bblayers.conf
```bitbake
# POKY_BBLAYERS_CONF_VERSION is increased each time build/conf/bblayers.conf
# changes incompatibly
POKY_BBLAYERS_CONF_VERSION = "2"

BBPATH = "${TOPDIR}"
BBFILES ?= ""

QT_LAYER = "${@os.path.isdir("${TOPDIR}/../meta-qt5")}"
VIRTUALIZATION_LAYER = "${@os.path.isdir("${TOPDIR}/../meta-virtualization")}"

BBLAYERS ?= " \
  ${TOPDIR}/../meta-gplv2 \
  ${TOPDIR}/../poky/meta \
  ${TOPDIR}/../poky/meta-poky \
  ${TOPDIR}/../poky/meta-yocto-bsp \
  ${TOPDIR}/../meta-renesas/meta-rz-common \
  ${TOPDIR}/../meta-renesas/meta-rzv2m \
  ${TOPDIR}/../meta-openembedded/meta-oe \
  ${TOPDIR}/../meta-openembedded/meta-python \
  ${TOPDIR}/../meta-openembedded/meta-multimedia \
  ${TOPDIR}/../meta-openembedded/meta-webserver \
  ${TOPDIR}/../meta-rz-features/meta-rz-bootloaders \
  ${TOPDIR}/../meta-rz-features/meta-rz-drpai \
  ${TOPDIR}/../meta-rz-features/meta-rz-isp \
  ${@'${TOPDIR}/../meta-qt5' if '${QT_LAYER}' == 'True' else ''} \
  ${@'${TOPDIR}/../meta-openembedded/meta-filesystems' if '${VIRTUALIZATION_LAYER}' == 'True' else ''} \
  ${@'${TOPDIR}/../meta-openembedded/meta-networking' if '${VIRTUALIZATION_LAYER}' == 'True' else ''} \
  ${@'${TOPDIR}/../meta-virtualization' if '${VIRTUALIZATION_LAYER}' == 'True' else ''} \
  ${TOPDIR}/../meta-mxt-rzv2m \
  "
```

## meta-mxt-rzv2m/conf/layer.conf
```bitbake
# We have a conf and classes directory, add to BBPATH

BBPATH .= ":${LAYERDIR}"

BBFILE_COLLECTIONS += "mxt-smarc"
BBFILE_PATTERN_mxt-smarc := "^${LAYERDIR}/"

BBFILE_PRIORITY_mxt-smarc = "20"

# We have recipes-* directories, add to BBFILES
BBFILES += "${LAYERDIR}/recipes-*/*/*.bb \
    ${LAYERDIR}/recipes-*/*.bb \
    ${LAYERDIR}/recipes-*/*.bbappend \
    ${LAYERDIR}/recipes-*/*/*.bbappend"
```

## meta-rz-features/meta-rz-bootloaders/conf/layer.conf
```bitbake
# We have a conf and classes directory, add to BBPATH
BBPATH .= ":${LAYERDIR}"

# We have recipes-* directories, add to BBFILES
BBFILES += "${LAYERDIR}/recipes-*/*/*.bb \
            ${LAYERDIR}/recipes-*/*/*.bbappend"

BBFILE_COLLECTIONS += "rz-bootloaders"
BBFILE_PATTERN_rz-bootloaders := "^${LAYERDIR}/"

LAYERDEPENDS_rz-bootloaders = "rz-common rzv2m"
LAYERSERIES_COMPAT_rz-bootloaders = "dunfell"
```

## meta-rz-features/meta-rz-isp/conf/layer.conf
```bitbake
# We have a conf and classes directory, add to BBPATH
BBPATH .= ":${LAYERDIR}"

# We have recipes-* directories, add to BBFILES
BBFILES += "${LAYERDIR}/recipes-*/*/*.bb \
            ${LAYERDIR}/recipes-*/*/*.bbappend \
            ${LAYERDIR}/recipes-*/*/*/*.bb \
            ${LAYERDIR}/recipes-*/*/*/*.bbappend"

BBFILE_COLLECTIONS += "rz-isp"
BBFILE_PATTERN_rz-isp := "^${LAYERDIR}/"

LAYERDEPENDS_rz-isp = "rzv2m"
LAYERSERIES_COMPAT_rz-isp = "dunfell"

PREFERRED_VERSION_libmetal="2018.10%"
PREFERRED_VERSION_open-amp="2018.10%"

LAYERVERSION_openamp-layer = "1"
```
